## meta-custom/conf/distro/custom-dev.conf
```bitbake
DISTRO = "custom-dev"
DISTRO_NAME = "Development Distro"

INHERIT += "poky"
INIT_MANAGER = "systemd"

EXTRA_IMAGE_FEATURES += "debug-tweaks empty-root-password"
IMAGE_INSTALL:append = " gdb strace ssh-server"
```

## meta-custom/conf/distro/custom-prod.conf
```bitbake
DISTRO = "custom-prod"
DISTRO_NAME = "Production Distro"

INHERIT += "poky"
INIT_MANAGER = "systemd"

EXTRA_IMAGE_FEATURES += "read-only-rootfs"
IMAGE_INSTALL:append = ""
```

## meta-custom/conf/distro/custom-test.conf
```bitbake
DISTRO = "custom-test"
DISTRO_NAME = "Test Distro"

INHERIT += "poky"
INIT_MANAGER = "systemd"

EXTRA_IMAGE_FEATURES += "debug-tweaks"
IMAGE_INSTALL:append = " ssh-server"
```

## meta-custom/conf/distro/my-dev.conf
```bitbake
DISTRO = "my-dev"
DISTRO_NAME = "Development Distro"
require conf/distro/my-prod.conf
```

## meta-custom/conf/distro/my-prod.conf
```bitbake
DISTRO = "my-prod"
DISTRO_NAME = "Production Distro"
require conf/distro/poky.conf
```

## meta-custom/conf/distro/my-vnv.conf
```bitbake
DISTRO = "my-vnv"
DISTRO_NAME = "Validation Distro"
require conf/distro/my-prod.conf
```

## meta-custom/conf/layer.conf
```bitbake
BBPATH .= ":${LAYERDIR}"
BBFILES += "${LAYERDIR}/recipes-*/*/*.bb"
LAYERSERIES_COMPAT_meta-custom = "kirkstone"
```
